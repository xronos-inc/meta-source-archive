## conf/layer.conf
```bitbake
# SPDX-FileCopyrightText: (c) 2025 Xronos Inc.
# SPDX-License-Identifier: BSD-3-Clause

MAINTAINER = "Xronos Inc."
DESCRIPTION = "Meta layer for source and license archival in the final image."

BBPATH .= ":${LAYERDIR}"

BBFILES += "${LAYERDIR}/recipes-*/*/*.bb \
            ${LAYERDIR}/recipes-*/*/*.bbappend"

BBFILE_COLLECTIONS += "meta-source-archive"
BBFILE_PATTERN_meta-source-archive = "^${LAYERDIR}/"
BBFILE_PRIORITY_meta-source-archive = "6"

LAYERDEPENDS_meta-source-archive = "core"
LAYERSERIES_COMPAT_meta-source-archive = "scarthgap"
```
